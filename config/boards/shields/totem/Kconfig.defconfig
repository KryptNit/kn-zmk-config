## config/boards/shields/totem/Kconfig.defconfig
```kconfig
# Copyright (c) 2022 The ZMK Contributors
# SPDX-License-Identifier: MIT

TOTEM
if SHIELD_TOTEM_RIGHT

config ZMK_KEYBOARD_NAME
    default "TOTEM_RIGHT"

endif
```

## config/boards/shields/ttm/Kconfig.defconfig
```kconfig
# Copyright (c) 2022 The ZMK Contributors
# SPDX-License-Identifier: MIT

if SHIELD_TTM

config ZMK_KEYBOARD_NAME
    default "Ttm"

endif
```

## config/boards/shields/ttm/Kconfig.shield
```kconfig
# Copyright (c) 2022 The ZMK Contributors
# SPDX-License-Identifier: MIT

config SHIELD_TTM
    def_bool $(shields_list_contains,ttm)
```
